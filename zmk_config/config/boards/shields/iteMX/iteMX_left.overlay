// iteMX_left.overlay

#include "iteMX.dtsi" // Notice that the main dtsi files are included in the overlay.

&kscan0 {
    col-gpios
        = <&xiao_d 9 GPIO_ACTIVE_HIGH> 
        , <&xiao_d 0 GPIO_ACTIVE_HIGH> 
        , <&xiao_d 1 GPIO_ACTIVE_HIGH> 
        , <&xiao_d 10 GPIO_ACTIVE_HIGH> 
        , <&xiao_d 4 GPIO_ACTIVE_HIGH> 
        , <&xiao_d 8 GPIO_ACTIVE_HIGH> 
        ;
};

// 0- 14     5v  -13
// 1- 13     GND -12
// 2- 12     3v3 -11
// 3- 11     4   -10
// 4- 10     5   -9
// 5- 9      6   -8
// 6- 8      7   -7