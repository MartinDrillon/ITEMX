## zmk_config/config/boards/shields/iteMX/Kconfig.defconfig
```kconfig
    if SHIELD_iteMX_right

config ZMK_KEYBOARD_NAME
    default "Clavier Martin"

config ZMK_SPLIT_ROLE_CENTRAL
    default y

endif

if SHIELD_iteMX_left || SHIELD_iteMX_right

config ZMK_SPLIT
    default y

endif
```

## zmk_config/config/boards/shields/iteMX/Kconfig.shield
```kconfig
config SHIELD_iteMX_left
    def_bool $(shields_list_contains,iteMX_left)

config SHIELD_iteMX_right
    def_bool $(shields_list_contains,iteMX_right)
```

## zmk_config/config/boards/shields/itemdeux/Kconfig.defconfig
```kconfig
    if SHIELD_itemdeux_left

config ZMK_KEYBOARD_NAME
    default "itemdeux"

config ZMK_SPLIT_ROLE_CENTRAL
    default y

endif

if SHIELD_itemdeux_left || SHIELD_itemdeux_right

config ZMK_SPLIT
    default y

endif
```

## zmk_config/config/boards/shields/itemdeux/Kconfig.shield
```kconfig
config SHIELD_itemdeux_left
    def_bool $(shields_list_contains,itemdeux_left)

config SHIELD_itemdeux_right
    def_bool $(shields_list_contains,itemdeux_right)
```

## zmk_config/config/boards/shields/itemtrois/Kconfig.defconfig
```kconfig
    if SHIELD_itemtrois_left

config ZMK_KEYBOARD_NAME
    default "itemtrois"

config ZMK_SPLIT_ROLE_CENTRAL
    default y

endif

if SHIELD_itemtrois_left || SHIELD_itemtrois_right

config ZMK_SPLIT
    default y

endif
```

## zmk_config/config/boards/shields/itemtrois/Kconfig.shield
```kconfig
config SHIELD_itemtrois_left
    def_bool $(shields_list_contains,itemtrois_left)

config SHIELD_itemtrois_right
    def_bool $(shields_list_contains,itemtrois_right)
```

## zmk_config/config/boards/shields/itemun/Kconfig.defconfig
```kconfig
    if SHIELD_itemun_left

config ZMK_KEYBOARD_NAME
    default "itemun"

config ZMK_SPLIT_ROLE_CENTRAL
    default y

endif

if SHIELD_itemun_left || SHIELD_itemun_right

config ZMK_SPLIT
    default y

endif
```

## zmk_config/config/boards/shields/itemun/Kconfig.shield
```kconfig
config SHIELD_itemun_left
    def_bool $(shields_list_contains,itemun_left)

config SHIELD_itemun_right
    def_bool $(shields_list_contains,itemun_right)
```
