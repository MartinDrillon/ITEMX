// itemdeux_right.overlay

#include "itemdeux.dtsi"

&default_transform { // The matrix transform for this board is 6 columns over because the left half is 6 columns wide according to the matrix.
    col-offset = <6>;
};

&kscan0 {
    col-gpios
        = <&pro_micro 9 GPIO_ACTIVE_HIGH> // col2 in the schematic
        , <&pro_micro 4 GPIO_ACTIVE_HIGH> // col3 in the schematic
        , <&pro_micro 3 GPIO_ACTIVE_HIGH> // col4 in the schematic
        , <&pro_micro 2 GPIO_ACTIVE_HIGH> // col5 in the schematic
        , <&pro_micro 0 GPIO_ACTIVE_HIGH> // col6 in the schematic
        , <&pro_micro 1 GPIO_ACTIVE_HIGH> // col7 in the schematic
        ;
};
